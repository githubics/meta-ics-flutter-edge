## conf/distro/flutter-edge-distro.conf
```bitbake
# Flutter Edge distro by ICS
require conf/distro/poky.conf

DISTRO = "flutter-edge-distro"
DISTRO_NAME = "Flutter Edge by ICS"
DISTRO_VERSION = "0.0"

SDK_VENDOR = "-ics"

DISTROOVERRIDES = "flutter-edge-distro"

# Log information on images and packages
INHERIT += "buildhistory"
BUILDHISTORY_COMMIT = "1"

# Use bluez5 as default.
DISTRO_FEATURES:append = " bluez5"

DISTRO_FEATURES:remove = "directfb"
DISTRO_FEATURES:append = " ipv6 x11 wayland pam systemd wifi"
VIRTUAL-RUNTIME_init_manager = "systemd"
DISTRO_FEATURES_BACKFILL_CONSIDERED:append = " sysvinit"
```

## conf/layer.conf
```bitbake
# We have a conf and classes directory, add to BBPATH
BBPATH .= ":${LAYERDIR}"

# We have recipes-* directories, add to BBFILES
BBFILES += "${LAYERDIR}/recipes-*/*/*.bb \
            ${LAYERDIR}/recipes-*/*/*.bbappend"

BBFILE_COLLECTIONS += "ics-flutter-edge"
BBFILE_PATTERN_ics-flutter-edge := "^${LAYERDIR}/"
BBFILE_PRIORITY_ics-flutter-edge = "10"

LAYERSERIES_COMPAT_ics-flutter-edge = "kirkstone"
```
